## Documentation/devicetree/bindings/misc/pamir-ai,sam.yaml
```yaml
# SPDX-License-Identifier: (GPL-2.0-only OR BSD-2-Clause)
%YAML 1.2
---
$id: http://devicetree.org/schemas/misc/pamir-ai,sam.yaml#
$schema: http://devicetree.org/meta-schemas/core.yaml#

title: Pamir AI Signal Aggregation Module (SAM)

maintainers:
  - Pamir AI Support <support@pamir.ai>

description: |
  The Pamir AI Signal Aggregation Module (SAM) is a communication protocol
  used to interface between a Linux host system and the RP2040 microcontroller
  in Pamir AI CM5 devices. This protocol enables bidirectional communication
  for hardware control and status reporting via UART.
  
  The SAM protocol handles buttons, LEDs, power management, display control,
  and system commands using a compact 4-byte packet format with checksum validation.

properties:
  compatible:
    const: pamir-ai,sam

  debug-level:
    $ref: /schemas/types.yaml#/definitions/uint32
    enum: [0, 1, 2, 3]
    default: 0
    description: |
      Debug level for kernel messages:
      0 = Off (no debug messages)
      1 = Error (error messages only)
      2 = Info (basic info + errors)
      3 = Verbose (detailed protocol information)

  ack-required:
    type: boolean
    default: false
    description: |
      Whether protocol commands require acknowledgment.
      Currently not implemented, for future use.

  recovery-timeout-ms:
    $ref: /schemas/types.yaml#/definitions/uint32
    default: 1000
    description: |
      Timeout in milliseconds for protocol recovery.
      Used if a packet transmission stalls.

  power-poll-interval-ms:
    $ref: /schemas/types.yaml#/definitions/uint32
    default: 1000
    description: |
      Interval in milliseconds for polling power metrics from the RP2040.
      Set to 0 to disable polling.

required:
  - compatible

additionalProperties: false

examples:
  - |
    #include <dt-bindings/clock/qcom,gcc-sdm845.h>

    serial@78b0000 {
        compatible = "qcom,msm-uartdm-v1.4", "qcom,msm-uartdm";
        reg = <0x78b0000 0x200>;
        interrupts = <0 108 0>;
        clocks = <&gcc GCC_BLSP1_UART2_APPS_CLK>,
                <&gcc GCC_BLSP1_AHB_CLK>;
        clock-names = "core", "iface";
        status = "okay";
        
        pamir_sam: pamir-sam {
            compatible = "pamir-ai,sam";
            debug-level = <2>;
            power-poll-interval-ms = <1000>;
        };
    };
```

## Documentation/devicetree/bindings/misc/pamir-ai-sam.yaml
```yaml
# SPDX-License-Identifier: (GPL-2.0-only OR BSD-2-Clause)
%YAML 1.2
---
$id: http://devicetree.org/schemas/misc/pamir-ai-sam.yaml#
$schema: http://devicetree.org/meta-schemas/core.yaml#

title: Pamir AI Signal Aggregation Module (SAM) Device Tree Bindings

maintainers:
  - Utsav Balar <utsavbalar1231@gmail.com>

description: |
  This binding describes the Pamir AI Signal Aggregation Module (SAM) overlay which
  enables communication between the host processor and an RP2040 microcontroller
  providing interface to hardware inputs and outputs on CM5 devices.
  
  The SAM module communicates over UART and provides an input interface for buttons,
  LED control functionality, power state management, and debugging capabilities.
  It also provides a character device interface (/dev/pamir-sam) for user-space
  applications to communicate directly with the microcontroller.

properties:
  compatible:
    const: pamir-ai,sam

  status:
    enum:
      - okay
      - disabled

  debug-level:
    type: integer
    default: 1
    description: |
      Debug verbosity level:
      0 - No debug messages (SAM_DEBUG_OFF)
      1 - Error messages only (SAM_DEBUG_ERROR)
      2 - Basic informational messages + errors (SAM_DEBUG_INFO)
      3 - Very verbose debugging with detailed protocol information (SAM_DEBUG_VERBOSE)

  recovery-timeout-ms:
    type: integer
    default: 1000
    description: Timeout in milliseconds for UART communication recovery

  ack-required:
    type: boolean
    description: Require acknowledgement packets for each command sent

required:
  - compatible
  - status

additionalProperties: false

examples:
  - |
    / {
      fragment@0 {
        target = <&uart0>;
        __overlay__ {
          status = "okay";
          pinctrl-names = "default";
          pinctrl-0 = <&uart0_pins>;
        };
      };

      fragment@1 {
        target = <&uart0>;
        __overlay__ {
          pamir_ai_sam: pamir-ai-sam {
            compatible = "pamir-ai,sam";
            status = "okay";
            debug-level = <2>;
            recovery-timeout-ms = <1000>;
            ack-required;
          };
        };
      };
    }; 
```

## drivers/misc/pamir-ai-sam/Kconfig
```kconfig
config PAMIR_AI_SAM_MODULE
	tristate "Pamir AI Signal Aggregation Module (SAM) driver"
	depends on SERIAL_DEV_BUS
	help
	  Say Y here to support Pamir AI's Signal Aggregation Module (SAM)
	  for communication between the host processor and RP2040 microcontroller.
	  
	  This driver interfaces with hardware components on the CM5 device,
	  including:
	  - Button input handling via Linux input subsystem
	  - RGB LED control (up to 16 LEDs with different animation modes)
	  - Boot/shutdown notifications via Linux reboot notifier
	  - Diagnostic information and debugging
	  
	  The driver also creates a character device at /dev/pamir-sam
	  for direct userspace communication with the microcontroller.
	  
	  Debug level can be controlled with the 'debug' module parameter
	  (0=off, 1=errors, 2=info, 3=verbose).
	  
	  To compile this driver as a module, choose M here: the module
	  will be called pamir-ai-sam. 
```
